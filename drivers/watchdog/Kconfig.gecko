## drivers/watchdog/Kconfig.gecko
```kconfig
# Kconfig - Watchdog configuration options
#
# Copyright (c) 2019 Interay Solutions B.V.
# Copyright (c) 2019 Oane Kingma
#
# SPDX-License-Identifier: Apache-2.0

config WDT_GECKO
	bool "Gecko series Watchdog (WDOG) Driver"
	depends on SOC_FAMILY_EXX32
	select SOC_GECKO_WDOG
	select HAS_DTS_WDT
	default y
	help
	  Enable WDOG driver for Silicon Labs Gecko MCUs.
```

## dts/bindings/watchdog/silabs,gecko-wdog.yaml
```yaml
# Copyright (c) 2019 Interay Solutions B.V.
# Copyright (c) Oane Kingma
# SPDX-License-Identifier: Apache-2.0

title: Silicon Labs Gecko Family Watchdog driver

description: >
    This binding gives a base representation of the Silicon Labs Gecko Watchdog

compatible: "silabs,gecko-wdog"

include: base.yaml

properties:
    reg:
      required: true

    label:
      required: true

    interrupts:
      required: true
```
